## CMakeLists.txt
```
cmake_minimum_required(VERSION 3.20.0)

# Use NEWLIB as libc to make it work with ARM GNU Toolchain out of the box.
set(TOOLCHAIN_HAS_NEWLIB ON)

# Common configuration fragment files
list(APPEND EXTRA_CONF_FILE
  "../../common/configs/base.conf"
  "../../common/configs/runtime-stats.conf"
)

# Common device tree overlays
if("${BOARD}" STREQUAL "mimxrt1180_evk/mimxrt1189/cm33")
  list(APPEND EXTRA_DTC_OVERLAY_FILE
    "../../common/overlays/mimxrt1180_evk_mimxrt1189_cm33_ocram1_ram.overlay"
  )
endif()

find_package(Zephyr REQUIRED HINTS $ENV{ZEPHYR_BASE})
project(networking)

include(../../common/libs/sys_heap_stats/sys_heap_stats.cmake)

target_sources(app PRIVATE src/main.c)
```

## Kconfig
```
# Copyright 2026 NXP
# SPDX-License-Identifier: BSD-3-Clause

source "Kconfig.zephyr"

rsource "../../common/libs/sys_heap_stats/Kconfig"
```

## prj.conf
```kconfig
# Use NEWLIB for ARM gcc
CONFIG_NEWLIB_LIBC=y


CONFIG_INIT_STACKS=y

# Logging
CONFIG_NET_DSA_LOG_LEVEL_INF=y

CONFIG_REQUIRES_FULL_LIBC=y

CONFIG_NET_HOSTNAME_ENABLE=y
CONFIG_NET_HOSTNAME="networking"

# DSA support
CONFIG_NET_DSA=y

CONFIG_NET_IF_MAX_IPV4_COUNT=7
CONFIG_NET_IF_MAX_IPV6_COUNT=7
```

## boards/mimxrt1180_evk_mimxrt1189_cm33.overlay
```dts
/* Make ocram1 as default RAM region */
/ {
	chosen {
		zephyr,sram  = &ocram1;
	};
};


/* Remove zephyr,memory-region causing MPU regions conflicts */
/delete-node/ &ocram1;

&memory {
	ocram1: memory@4000 {
		compatible = "mmio-sram";
		/* OCRAM1 first 16K access is blocked by TRDC */
		reg = <0x4000 DT_SIZE_K(496)>;
		#address-cells = <1>;
		#size-cells = <1>;
	};
};
```

## src/main.c
```c
/*
 * Copyright 2026 NXP
 *
 * SPDX-License-Identifier: BSD-3-Clause
 */

#include <zephyr/kernel.h>

#include <zephyr/net/net_if.h>
#include <zephyr/net/ethernet.h>

#ifdef CONFIG_NET_DHCPV4
static void start_dhcpv4_client(struct net_if *iface, void *user_data)
{
    ARG_UNUSED(user_data);
    struct ethernet_context *eth_ctx;

    if (net_if_l2(iface) != &NET_L2_GET_NAME(ETHERNET)) {
        return;
    }

#ifdef CONFIG_NET_DSA
    eth_ctx = net_if_l2_data(iface);

    /* Skip if this is a DSA port */
    if (eth_ctx && (eth_ctx->dsa_port != NON_DSA_PORT)) {
        return;
    }
#endif

    printk("%s: start on %s: index=%d\n", __func__,
        net_if_get_device(iface)->name, net_if_get_by_iface(iface));

    net_dhcpv4_start(iface);
}
#else
static void start_dhcpv4_client(struct net_if *iface, void *user_data)
{
    return;
}
#endif

static void ipv4_init(void)
{
    net_if_foreach(start_dhcpv4_client, NULL);
}

int main(void)
{
    ipv4_init();

    printk("main: done\n");

    return 0;
}
```
