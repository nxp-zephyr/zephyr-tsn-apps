## apps/tsn_app/Kconfig
```kconfig
# Copyright 2026 NXP
# SPDX-License-Identifier: BSD-3-Clause

source "Kconfig.zephyr"

rsource "../../common/libs/sys_heap_stats/Kconfig"

rsource "../../common/configs/Kconfig.tsn_apps"

rsource "Kconfig.multicore"

config APP_STORAGE
    bool "Enable storage support"
    default y

choice APP_TSN_BUILD_PROFILE
    prompt "TSN application build profile options"
    default APP_TSN_BUILD_PROFILE_DEFAULT

    config APP_TSN_BUILD_PROFILE_DEFAULT
        bool "TSN Bridge default profile"
        select APP_TSN_BRIDGE
        select APP_QBV
        select APP_FP
endchoice
```

## apps/tsn_app/boards/mimxrt1180_evk_mimxrt1189_cm33.conf
```kconfig
# Copyright 2026 NXP
# SPDX-License-Identifier: BSD-3-Clause

CONFIG_HEAP_MEM_POOL_SIZE=81920
CONFIG_SYS_HEAP_SMALL_ONLY=y
```

## apps/tsn_app/secondary/Kconfig
```kconfig
# Copyright 2026 NXP
# SPDX-License-Identifier: BSD-3-Clause

source "Kconfig.zephyr"

rsource "../../../common/libs/sys_heap_stats/Kconfig"

rsource "../../../common/configs/Kconfig.tsn_apps"

rsource "../Kconfig.multicore"

choice APP_TSN_BUILD_PROFILE
    prompt "TSN application build profile options"
    default APP_TSN_BUILD_PROFILE_DEFAULT

    config APP_TSN_BUILD_PROFILE_DEFAULT
        bool "TSN Endpoint default profile"
        select APP_TSN_ENDPOINT

endchoice
```

## apps/tsn_app/secondary/boards/mimxrt1180_evk_mimxrt1189_cm7.conf
```kconfig
# Copyright 2026 NXP
# SPDX-License-Identifier: BSD-3-Clause

CONFIG_HEAP_MEM_POOL_SIZE=65536

CONFIG_BUILD_OUTPUT_HEX=y
CONFIG_SECOND_CORE_MCUX=y

# define MPU regions ourselves
CONFIG_NXP_BOARD_SPECIFIC_MPU_SETTINGS=n
```

## common/configs/Kconfig.tsn_apps
```kconfig
# Copyright 2026 NXP
# SPDX-License-Identifier: BSD-3-Clause

config APP_TSN_ENDPOINT
    bool
    default n
    help
        TSN endpoint configuration support

config APP_TSN_BRIDGE
    bool
    default n
    depends on !TSN_MULTICORE_SECONDARY
    help
        TSN bridge configuration support

config APP_QBV
    bool
    default n
    help
        QBV support

config APP_FP
    bool
    default n
    help
        FP support
```

## common/libs/sys_heap_stats/Kconfig
```kconfig
# Copyright 2026 NXP
# SPDX-License-Identifier: BSD-3-Clause

config SYS_HEAP_STATS_PERIODIC_LOG
    bool "Enable periodic system heap statistics logging"
    select SYS_HEAP_RUNTIME_STATS
    default n
    help
      Periodically log system heap statistics including free bytes,
      allocated bytes, and maximum allocated bytes.

if SYS_HEAP_STATS_PERIODIC_LOG

config SYS_HEAP_STATS_PERIODIC_LOG_PERIOD
    int "Period in milliseconds for heap statistics logging"
    default 20000
    help
      Specifies how often System heap statistics shall be logged.
      0 means that there is no logging.

endif
```

## dts/bindings/genavbtsn/genavbtsn-eth.yaml
```yaml
description: GenAVB/TSN Ethernet interface

compatible: "nxp,genavbtsn-eth"

include: base.yaml

properties:
  port-id:
    type: int
    required: true
    description: GenAVB/TSN logical port id mapped to this interface
```

## west.yml
```yaml
manifest:
  defaults:
    remote: nxp_zephyr
  remotes:
    - name: nxp
      url-base: https://github.com/NXP
    - name: nxp_zephyr
      url-base: https://github.com/nxp-zephyr
  projects:
    - name: nxp-zephyr
      west-commands: scripts/west-commands.yml
      revision: e07ad58e9403bc225cc727b2c31cf1c8b68bd60a
      import:
        name-allowlist:
          - cmsis_6
          - picolibc
          - littlefs
      path: zephyr
    - name: hal_nxp
      revision: 9120ddc21af473b3b4889dbc4d26bef6196625a8
      path: modules/hal/nxp

    - name: GenAVB_TSN
      remote: nxp
      revision: refs/tags/8_2_0
      path: gen_avb
    - name: rtos-abstraction-layer
      remote: nxp
      revision: refs/tags/1_8_0
    - name: rtos-apps
      remote: nxp
      revision: refs/tags/1_4_0

    # Include modules to prevent Kconfig issues
    - name: els_pkc
      remote: nxp
      repo-path: els_pkc
      revision: c37a05831caf542ff240c3cb6a54da469d5e3c57
      path: modules/crypto/els_pkc
    - name: psa_crypto_driver
      remote: nxp
      repo-path: psa_crypto_driver
      revision: 54518163c46c5a63b00ea416f2660139e91d9841
      path: modules/crypto/psa_crypto_driver
```
